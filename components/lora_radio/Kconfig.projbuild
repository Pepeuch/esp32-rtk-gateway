## components/lora_radio/Kconfig.projbuild
```kconfig
menu "LoRa Radio"

choice LORA_REGION
    prompt "LoRa region"
    default LORA_REGION_EU868
    help
        Regional radio profile used to resolve default frequency and policy placeholders.
        These settings are configurable placeholders, not legal guarantees.

config LORA_REGION_EU868
    bool "EU868"

config LORA_REGION_US915
    bool "US915"

config LORA_REGION_AU915
    bool "AU915"

config LORA_REGION_AS923
    bool "AS923"

config LORA_REGION_CUSTOM
    bool "CUSTOM"

endchoice

choice LORA_CHIP_FAMILY
    prompt "LoRa chip family"
    default LORA_CHIP_FAMILY_SX1262

config LORA_CHIP_FAMILY_SX1261
    bool "SX1261"

config LORA_CHIP_FAMILY_SX1262
    bool "SX1262"

config LORA_CHIP_FAMILY_SX1268
    bool "SX1268"

config LORA_CHIP_FAMILY_LLCC68
    bool "LLCC68"

endchoice

config LORA_FREQUENCY_HZ
    int "LoRa frequency (Hz)"
    default 0
    range 0 1000000000 if !LORA_REGION_CUSTOM
    range 1 1000000000 if LORA_REGION_CUSTOM
    help
        Set to 0 to resolve automatically from the selected region profile.
        CUSTOM requires an explicit non-zero frequency.

config LORA_TX_POWER_DBM
    int "LoRa TX power (dBm)"
    default 14
    range -9 30
    help
        Requested TX power in dBm. The runtime config will clamp it to the
        selected region profile max placeholder.

choice LORA_RADIO_PROFILE
    prompt "LoRa radio profile"
    default LORA_RADIO_PROFILE_RTK_FAST

config LORA_RADIO_PROFILE_RTK_FAST
    bool "rtk_fast"

config LORA_RADIO_PROFILE_CUSTOM
    bool "custom"

endchoice

choice LORA_RTCM_PROFILE
    prompt "LoRa RTCM profile"
    default LORA_RTCM_PROFILE_RTK_MINIMAL

config LORA_RTCM_PROFILE_RTK_MINIMAL
    bool "rtk_minimal"

config LORA_RTCM_PROFILE_CUSTOM
    bool "custom"

endchoice

endmenu
```

## main/Kconfig.projbuild
```kconfig
choice APP_BOARD_TYPE
    prompt "Target board"
    default BOARD_WAVESHARE_ESP32S3_ETH

config BOARD_WAVESHARE_ESP32S3_ETH
    bool "Waveshare ESP32-S3-ETH"

config BOARD_MAMMOTION_ESP32S3
    bool "Mammotion ESP32-S3"

config BOARD_GENERIC_ESP32C3
    bool "Generic ESP32-C3"

config BOARD_GENERIC_ESP32C6
    bool "Generic ESP32-C6"

config BOARD_GENERIC_ESP32
    bool "Generic ESP32"

config BOARD_GENERIC_ESP32_ETH
    bool "Generic ESP32 ETH"

endchoice

config ETHERNET_DHCP_TIMEOUT_MS
    int "Ethernet DHCP timeout (ms)"
    default 12000
    range 1000 60000
    help
        How long to wait for an Ethernet IPv4 address after the PHY link is up
        before starting WiFi fallback. This is only a firmware policy timeout,
        not a guarantee about network behavior.

choice GNSS_RECEIVER_DEFAULT
    prompt "Default GNSS receiver family"
    default GNSS_RECEIVER_DEFAULT_AUTO

config GNSS_RECEIVER_DEFAULT_AUTO
    bool "Auto detect"

config GNSS_RECEIVER_DEFAULT_UBLOX
    bool "u-blox"

config GNSS_RECEIVER_DEFAULT_UNICORE
    bool "Unicore"

config GNSS_RECEIVER_DEFAULT_NMEA
    bool "Generic NMEA"

config GNSS_RECEIVER_DEFAULT_SEPTENTRIO
    bool "Septentrio"

endchoice

choice RTK_DEVICE_ROLE
    prompt "RTK device role"
    default RTK_DEVICE_ROLE_BASE

config RTK_DEVICE_ROLE_BASE
    bool "BASE"
    help
        Build the RTK base pipeline: GNSS UART input, RTCM filtering,
        LoRa fragmentation/transmit, and network or storage features if available.

config RTK_DEVICE_ROLE_ROVER
    bool "ROVER"
    help
        Build the RTK rover pipeline: LoRa receive/reassembly and GNSS UART output only.
        Ethernet, SD, web server, and NTRIP features stay disabled.

config RTK_DEVICE_ROLE_DUAL_DEBUG
    bool "DUAL_DEBUG"
    help
        Build both pipelines for ESP32-S3 debug and loop testing.
        Intended for development use rather than deployment.

endchoice
```
